## config/boards/arm/underscore33-bigspace/Kconfig.board
```kconfig
# Copyright (c) 2020 The ZMK Contributors
# SPDX-License-Identifier: MIT

config BOARD_underscore33
	bool "underscore33"
	depends on SOC_NRF52840_QIAA
```

## config/boards/arm/underscore33/Kconfig.defconfig
```kconfig
# Copyright (c) 2020 The ZMK Contributors
# SPDX-License-Identifier: MIT

if BOARD_underscore33

config ZMK_KEYBOARD_NAME
    default "_33BLE"

config BOARD
	default "underscore33"

if USB

config USB_NRFX
	default y

config USB_DEVICE_STACK
	default y

endif # USB

config BT_CTLR
	default BT

config ZMK_BLE
	default y

config ZMK_USB
	default y

config ZMK_BATTERY_VOLTAGE_DIVIDER
	default y

endif # BOARD_underscore33
```
